VERSION ""

NS_ :

BS_:

BU_: XXX

BO_ 1664 TRACK_C_0: 8 XXX
 SG_ LEAD_STOP : 47|2@0+ (1,0) [0|63] "" XXX
 SG_ NEW_SIGNAL_1 : 7|1@1+ (1,0) [0|3] "" XXX
 SG_ NEW_SIGNAL_3 : 0|6@1+ (1,0) [0|15] "" XXX
 SG_ NEW_SIGNAL_2 : 6|1@1+ (1,0) [0|3] "" XXX
 SG_ LAT_SPEED : 48|8@1+ (1,-128) [0|3] "kph" XXX
 SG_ LAT_DIST : 20|12@1+ (0.015,-32) [0|7] "m" XXX
 SG_ LONG_DIST : 8|12@1+ (0.06,-1) [0|127] "m" XXX
 SG_ LEAD_SPEED : 32|10@1+ (0.5,-256) [0|65535] "kph" XXX
 SG_ NEW_SIGNAL_4 : 45|4@0+ (1,0) [0|3] "" XXX
 SG_ SCORE : 57|7@1+ (1,0) [0|3] "" XXX
 SG_ VALID : 63|1@1+ (1,0) [0|3] "" XXX

BO_ 1665 TRACK_C_1: 8 XXX
 SG_ LEAD_STOP : 47|2@0+ (1,0) [0|63] "" XXX
 SG_ NEW_SIGNAL_1 : 7|1@1+ (1,0) [0|3] "" XXX
 SG_ NEW_SIGNAL_3 : 0|6@1+ (1,0) [0|15] "" XXX
 SG_ NEW_SIGNAL_2 : 6|1@1+ (1,0) [0|3] "" XXX
 SG_ LAT_SPEED : 48|8@1+ (1,-128) [0|3] "kph" XXX
 SG_ LAT_DIST : 20|12@1+ (0.015,-32) [0|7] "m" XXX
 SG_ LONG_DIST : 8|12@1+ (0.06,-1) [0|127] "m" XXX
 SG_ LEAD_SPEED : 32|10@1+ (0.5,-256) [0|65535] "kph" XXX
 SG_ NEW_SIGNAL_4 : 45|4@0+ (1,0) [0|3] "" XXX
 SG_ SCORE : 57|7@1+ (1,0) [0|3] "" XXX
 SG_ VALID : 63|1@1+ (1,0) [0|3] "" XXX

BO_ 1666 TRACK_C_2: 8 XXX
 SG_ LEAD_STOP : 47|2@0+ (1,0) [0|63] "" XXX
 SG_ NEW_SIGNAL_1 : 7|1@1+ (1,0) [0|3] "" XXX
 SG_ NEW_SIGNAL_3 : 0|6@1+ (1,0) [0|15] "" XXX
 SG_ NEW_SIGNAL_2 : 6|1@1+ (1,0) [0|3] "" XXX
 SG_ LAT_SPEED : 48|8@1+ (1,-128) [0|3] "kph" XXX
 SG_ LAT_DIST : 20|12@1+ (0.015,-32) [0|7] "m" XXX
 SG_ LONG_DIST : 8|12@1+ (0.06,-1) [0|127] "m" XXX
 SG_ LEAD_SPEED : 32|10@1+ (0.5,-256) [0|65535] "kph" XXX
 SG_ NEW_SIGNAL_4 : 45|4@0+ (1,0) [0|3] "" XXX
 SG_ SCORE : 57|7@1+ (1,0) [0|3] "" XXX
 SG_ VALID : 63|1@1+ (1,0) [0|3] "" XXX

BO_ 1667 TRACK_C_3: 8 XXX
 SG_ LEAD_STOP : 47|2@0+ (1,0) [0|63] "" XXX
 SG_ NEW_SIGNAL_1 : 7|1@1+ (1,0) [0|3] "" XXX
 SG_ NEW_SIGNAL_3 : 0|6@1+ (1,0) [0|15] "" XXX
 SG_ NEW_SIGNAL_2 : 6|1@1+ (1,0) [0|3] "" XXX
 SG_ LAT_SPEED : 48|8@1+ (1,-128) [0|3] "kph" XXX
 SG_ LAT_DIST : 20|12@1+ (0.015,-32) [0|7] "m" XXX
 SG_ LONG_DIST : 8|12@1+ (0.06,-1) [0|127] "m" XXX
 SG_ LEAD_SPEED : 32|10@1+ (0.5,-256) [0|65535] "kph" XXX
 SG_ NEW_SIGNAL_4 : 45|4@0+ (1,0) [0|3] "" XXX
 SG_ SCORE : 57|7@1+ (1,0) [0|3] "" XXX
 SG_ VALID : 63|1@1+ (1,0) [0|3] "" XXX

BO_ 1668 TRACK_C_4: 8 XXX
 SG_ LEAD_STOP : 47|2@0+ (1,0) [0|63] "" XXX
 SG_ NEW_SIGNAL_1 : 7|1@1+ (1,0) [0|3] "" XXX
 SG_ NEW_SIGNAL_3 : 0|6@1+ (1,0) [0|15] "" XXX
 SG_ NEW_SIGNAL_2 : 6|1@1+ (1,0) [0|3] "" XXX
 SG_ LAT_SPEED : 48|8@1+ (1,-128) [0|3] "kph" XXX
 SG_ LAT_DIST : 20|12@1+ (0.015,-32) [0|7] "m" XXX
 SG_ LONG_DIST : 8|12@1+ (0.06,-1) [0|127] "m" XXX
 SG_ LEAD_SPEED : 32|10@1+ (0.5,-256) [0|65535] "kph" XXX
 SG_ NEW_SIGNAL_4 : 45|4@0+ (1,0) [0|3] "" XXX
 SG_ SCORE : 57|7@1+ (1,0) [0|3] "" XXX
 SG_ VALID : 63|1@1+ (1,0) [0|3] "" XXX

BO_ 1669 TRACK_C_5: 8 XXX
 SG_ LEAD_STOP : 47|2@0+ (1,0) [0|63] "" XXX
 SG_ NEW_SIGNAL_1 : 7|1@1+ (1,0) [0|3] "" XXX
 SG_ NEW_SIGNAL_3 : 0|6@1+ (1,0) [0|15] "" XXX
 SG_ NEW_SIGNAL_2 : 6|1@1+ (1,0) [0|3] "" XXX
 SG_ LAT_SPEED : 48|8@1+ (1,-128) [0|3] "kph" XXX
 SG_ LAT_DIST : 20|12@1+ (0.015,-32) [0|7] "m" XXX
 SG_ LONG_DIST : 8|12@1+ (0.06,-1) [0|127] "m" XXX
 SG_ LEAD_SPEED : 32|10@1+ (0.5,-256) [0|65535] "kph" XXX
 SG_ NEW_SIGNAL_4 : 45|4@0+ (1,0) [0|3] "" XXX
 SG_ SCORE : 57|7@1+ (1,0) [0|3] "" XXX
 SG_ VALID : 63|1@1+ (1,0) [0|3] "" XXX

CM_ SG_ 1664 LEAD_STOP "lead below 3kph";
CM_ SG_ 1664 SCORE "127 = confident, 87 = low confidence, 0 = no tracking";
